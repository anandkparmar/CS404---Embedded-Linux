/********************************************************************************8
* Copyright (C) 2012 Texas Instruments Incorporated - http://www.ti.com/
*
* This program is free software; you can redistribute it and/or modify
* it under the terms of the GNU General Purpose License Version 2 as
* published by the Free Software Foundation
*
* Original from: github.com/jadonk/validation-scripts/blob/master/test-capemgr/
*
* Modified by Derek Molloy for the example on www.derekmolloy.ie
* that maps GPIO pins for the example
**************************************************************************************/

/***************************
Name: Parmar Anandkumar K
Roll no: B12021
Year: 4th year
Date: 2 Nov, 2015
**************************/

/dts-v1/;
/plugin/;

/{
   compatible = "ti,beaglebone", "ti,beaglebone-black";
   part-number = "PAR-gpio-set";
   version = "00A0";

   fragment@0 {
       target = <&am33xx_pinmux>;
            
       __overlay__ {
           pinctrl_test: PAR-gpio-set {
       pinctrl-single,pins = <

           0x040 0x37 // P9_42 INPUT MODE7 pullup 
                                 
           /* OUTPUT  GPIO(mode7) 0x07 pulldown, 0x17 pullup, 0x?f no pullup/down */
           /* INPUT   GPIO(mode7) 0x27 pulldown, 0x37 pullup, 0x?f no pullup/down */

       >;
      };
     };
   };
};